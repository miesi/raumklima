## components/board/Kconfig
```kconfig
menu "Board"

    choice HUB_BOARD
        prompt "Board"
        default HUB_BOARD_CROWPANEL_579
        config HUB_BOARD_CROWPANEL_579
            bool "Elecrow CrowPanel ESP32 E-Paper 5.79in (DIS08792E)"
    endchoice

    config HUB_I2C_SDA_GPIO
        int "I2C SDA GPIO"
        default 3
        help
            CrowPanel 5.79: header U5 pin 1. GPIO3 is a strapping pin only if
            eFuse STRAP_JTAG_SEL is set (it is not). See docs/hardware-crowpanel-579.md.

    config HUB_I2C_SCL_GPIO
        int "I2C SCL GPIO"
        default 8
        help
            CrowPanel 5.79: header U5 pin 20.

    config HUB_I2C2_ENABLE
        bool "Second I2C bus"
        default y
        help
            A second bus on its own I2C controller, e.g. to separate one sensor from the others.
            Harmless when nothing is connected.

    config HUB_I2C2_SDA_GPIO
        int "I2C bus 2 SDA GPIO"
        depends on HUB_I2C2_ENABLE
        default 15
        help
            CrowPanel 5.79: header U5 pin 3, nothing else on the board (schematic).

    config HUB_I2C2_SCL_GPIO
        int "I2C bus 2 SCL GPIO"
        depends on HUB_I2C2_ENABLE
        default 16
        help
            CrowPanel 5.79: header U5 pin 18, nothing else on the board (schematic).

    config HUB_I2C_FREQ_HZ
        int "I2C clock in Hz"
        default 100000
        help
            100 kHz: safe with long jumper wires and breakout pull-ups of unknown value.

endmenu
```

## hub/components/metrics/Kconfig
```kconfig
menu "Metrics"
    config HUB_METRICS_MAX
        int "Maximum number of metric keys"
        default 128
        range 8 256
        help
            Table full: a new key replaces the oldest stale one (a renamed or removed probe);
            without a stale one it is dropped with an error and a warning on the display.
            Set it just below the number of keys in "show status" to test that.
endmenu
```

## hub/components/sensors/Kconfig
```kconfig
menu "Sensors"
    config HUB_SENSORS_MAX
        int "Maximum number of I2C sensor instances"
        default 8
        range 1 16
        help
            More sensors found than this: error message, the first ones found are used.
            Set it to 1 to test the overflow handling with two sensors.
endmenu
```
